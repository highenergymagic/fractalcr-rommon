## buildroot/configs/fractalcr_rommon_defconfig
```kconfig
BR2_x86_64=y
BR2_REPRODUCIBLE=y
BR2_PACKAGE_OVERRIDE_FILE="$(BR2_EXTERNAL_FRACTALCR_PATH)/security-overrides.mk"
BR2_GLOBAL_PATCH_DIR="$(BR2_EXTERNAL_FRACTALCR_PATH)/patches"
BR2_TOOLCHAIN_BUILDROOT=y
BR2_TOOLCHAIN_BUILDROOT_MUSL=y
BR2_KERNEL_HEADERS_6_12=y
BR2_TARGET_GENERIC_HOSTNAME="rommon"
BR2_INIT_NONE=y
BR2_SYSTEM_BIN_SH_NONE=y
# BR2_TARGET_GENERIC_REMOUNT_ROOTFS_RW is not set
# BR2_TARGET_GENERIC_GETTY is not set
BR2_PACKAGE_BUSYBOX=y
BR2_PACKAGE_BUSYBOX_CONFIG="$(BR2_EXTERNAL_FRACTALCR_PATH)/board/busybox.config"
# BR2_TARGET_ROOTFS_TAR is not set
BR2_TARGET_ROOTFS_CPIO=y
BR2_TARGET_ROOTFS_CPIO_GZIP=y
BR2_PACKAGE_ROMMON=y
BR2_PACKAGE_LIBOPENSSL_BIN=n
BR2_PACKAGE_LIBOPENSSL_ENGINES=n
BR2_PACKAGE_LIBOPENSSL_ENABLE_CHACHA=n
BR2_PACKAGE_LIBOPENSSL_ENABLE_RC4=n
BR2_ROOTFS_POST_BUILD_SCRIPT="$(BR2_EXTERNAL_FRACTALCR_PATH)/board/prune-rommon.sh"
```

## buildroot/package/rommon/Config.in
```kconfig
config BR2_PACKAGE_ROMMON
	bool "FractalCR ROM Monitor"
	select BR2_PACKAGE_OPENSSL
	select BR2_PACKAGE_LIBOPENSSL
	help
	  Supervised serial recovery services with an embedded release key and verified kexec.
```
